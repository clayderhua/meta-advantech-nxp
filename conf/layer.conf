## conf/machine/imx8mprom5722a1.conf
```bitbake
MACHINEOVERRIDES =. "imx8mp-lpddr4-evk:"
require conf/machine/imx8mp-lpddr4-evk.conf

KERNEL_DEVICETREE_BASENAME = "imx8mp-rom5722-a1"

KERNEL_DEVICETREE:imx8mprom5722a1 = "freescale/${KERNEL_DEVICETREE_BASENAME}.dtb"

UBOOT_DTB_NAME = "imx8mp-evk.dtb"

INHERIT += "cve-check"
UBOOT_DTB_NAME = "imx8mp-evk.dtb"
INHERIT:remove = "create-spdx"
INHERIT += "create-spdx-2.2"
SPDX_GENERATE_PACKAGE = "1"
```

## conf/machine/imx8mprsb3720a2.conf
```bitbake
MACHINEOVERRIDES =. "imx8mp-lpddr4-evk:"
require conf/machine/imx8mp-lpddr4-evk.conf

PREFERRED_PROVIDER_virtual/kernel = "linux-imx"

KERNEL_DEVICETREE_BASENAME = "imx8mp-rsb3720-a2"
KERNEL_DEVICETREE:imx8mprsb3720a2 = "freescale/${KERNEL_DEVICETREE_BASENAME}.dtb"

SERIAL_CONSOLES = "115200;ttymxc2"
ATF_BOOT_UART_BASE = "0x30880000"
UBOOT_DTB_NAME = "imx8mp-evk.dtb"

INHERIT += "cve-check"
UBOOT_DTB_NAME = "imx8mp-evk.dtb"
INHERIT:remove = "create-spdx"
INHERIT += "create-spdx-2.2"
SPDX_GENERATE_PACKAGE = "1"
```

## conf/machine/imx8ulprom2620a1.conf
```bitbake
MACHINEOVERRIDES =. "imx8ulp-lpddr4-evk:"
require conf/machine/imx8ulp-lpddr4-evk.conf

KERNEL_DEVICETREE_BASENAME = "imx8ulp-rom2620-a1"

# Find a better way to do it
KERNEL_DEVICETREE:remove = "\
    freescale/${KERNEL_DEVICETREE_BASENAME}-epdc.dtb \
    freescale/${KERNEL_DEVICETREE_BASENAME}-flexio-i2c.dtb \
    freescale/${KERNEL_DEVICETREE_BASENAME}-i3c.dtb \
    freescale/${KERNEL_DEVICETREE_BASENAME}-lpa.dtb \
    freescale/${KERNEL_DEVICETREE_BASENAME}-lpspi-slave.dtb \
    freescale/${KERNEL_DEVICETREE_BASENAME}-nd.dtb \
    freescale/${KERNEL_DEVICETREE_BASENAME}-rk055hdmipi4m.dtb \
    freescale/${KERNEL_DEVICETREE_BASENAME}-rk055hdmipi4mv2.dtb \
    freescale/${KERNEL_DEVICETREE_BASENAME}-sof-btsco.dtb \
    freescale/${KERNEL_DEVICETREE_BASENAME}-tpm.dtb \
    "

KERNEL_DEVICETREE:append = " \
    freescale/${KERNEL_DEVICETREE_BASENAME}-m2-sdio.dtb \
"

MACHINE_FEATURES:append = " soc-reva2"
MACHINE_FEATURES:remove = " soc-reva1"

IMXBOOT_TARGETS = "flash_singleboot_m33 flash_dualboot_m33"

IMAGE_INSTALL:append = " gstreamer1.0-libav"
LICENSE_FLAGS_ACCEPTED = "commercial"

INHERIT += "cve-check"
UBOOT_DTB_NAME = "imx8mp-evk.dtb"
INHERIT:remove = "create-spdx"
INHERIT += "create-spdx-2.2"
SPDX_GENERATE_PACKAGE = "1"
```

## conf/machine/imx93afee420a1.conf
```bitbake
#@TYPE: Machine
#@NAME: i.MX93
#@DESCRIPTION: Machine configuration for Advantech i.MX 93 AFE-E420 Board
#@MAINTAINER: Advantech RISC SW Team

MACHINEOVERRIDES =. "imx93-11x11-lpddr4x-evk:imx93afee420a1:"

require conf/machine/imx93-11x11-lpddr4x-evk.conf

KERNEL_DEVICETREE_BASENAME = "imx93-afee420-a1"

# Find a better way to do it
KERNEL_DEVICETREE:remove = "\
    freescale/${KERNEL_DEVICETREE_BASENAME}-aud-hat.dtb \
    freescale/${KERNEL_DEVICETREE_BASENAME}-boe-wxga-lvds-panel.dtb \
    freescale/${KERNEL_DEVICETREE_BASENAME}-flexio-i2c.dtb \
    freescale/${KERNEL_DEVICETREE_BASENAME}-flexspi-m2.dtb \
    freescale/${KERNEL_DEVICETREE_BASENAME}-i3c.dtb \
    freescale/${KERNEL_DEVICETREE_BASENAME}-inmate.dtb \
    freescale/${KERNEL_DEVICETREE_BASENAME}-ld.dtb \
    freescale/${KERNEL_DEVICETREE_BASENAME}-lpspi-slave.dtb \
    freescale/${KERNEL_DEVICETREE_BASENAME}-lpspi.dtb \
    freescale/${KERNEL_DEVICETREE_BASENAME}-lpuart.dtb \
    freescale/${KERNEL_DEVICETREE_BASENAME}-mqs.dtb \
    freescale/${KERNEL_DEVICETREE_BASENAME}-mt9m114.dtb \
    freescale/${KERNEL_DEVICETREE_BASENAME}-rm67199.dtb \
    freescale/${KERNEL_DEVICETREE_BASENAME}-root.dtb \
    freescale/${KERNEL_DEVICETREE_BASENAME}-rpmsg.dtb \
    freescale/${KERNEL_DEVICETREE_BASENAME}-rpmsg-lpv.dtb \
    freescale/${KERNEL_DEVICETREE_BASENAME}-iw612-otbr.dtb \
    freescale/${KERNEL_DEVICETREE_BASENAME}-i2c-spi-slave.dtb \
"

INHERIT += "cve-check"
UBOOT_DTB_NAME = "imx8mp-evk.dtb"
INHERIT:remove = "create-spdx"
INHERIT += "create-spdx-2.2"
SPDX_GENERATE_PACKAGE = "1"
```

## conf/machine/imx95aom5521a2.conf
```bitbake
#@TYPE: Machine
#@NAME: Advantech i.MX95 AOM-5521 Board rev A2
#@DESCRIPTION: Machine configuration for Advantech i.MX95 AOM-5521 Board rev A2
#@MAINTAINER: Advantech RISC SW team

MACHINEOVERRIDES =. "mx95:"

require conf/machine/include/imx95-evk.inc

MACHINE_FEATURES:append:use-nxp-bsp = " nxp9098-pcie"

KERNEL_DEVICETREE_BASENAME = "imx95-aom5521-a2"

UBOOT_CONFIG_BASENAME = "imx95_19x19_evk"

IMXBOOT_TARGETS_BASENAME = "flash"


OEI_BOARD = "mx95lp5_aom5521a2_8G"
OEI_DDR_CONFIG = "lpddr5_timing"
DDR_TYPE  = "lpddr5"

DDR_FIRMWARE_NAME = " \
	lpddr5_dmem_v202409.bin \
	lpddr5_dmem_qb_v202409.bin \
	lpddr5_imem_v202409.bin \
	lpddr5_imem_qb_v202409.bin \
"

M4_DEFAULT_IMAGE_MX95 = "${@bb.utils.contains('SYSTEM_MANAGER_CONFIG', 'mx95netc', 'imx95-19x19-evk_m7_TCM_netc_share.bin', \
                                                                                   'imx95-19x19-evk_m7_TCM_power_mode_switch.bin', d)}"

IMAGE_BOOT_FILES:append = " \
    mcore-demos/imx95-19x19-evk_m7_TCM_flexcan_linux.bin \
    mcore-demos/imx95-19x19-evk_m7_TCM_netc_share.bin \
    mcore-demos/imx95-19x19-evk_m7_TCM_power_mode_switch.bin \
    mcore-demos/imx95-19x19-evk_m7_TCM_rpmsg_lite_pingpong_rtos_linux_remote.bin \
    mcore-demos/imx95-19x19-evk_m7_TCM_rpmsg_lite_str_echo_rtos.bin \
    mcore-demos/imx95-19x19-evk_m7_TCM_sai_low_power_audio.bin \
    ${@bb.utils.contains('COMBINED_FEATURES', 'xen', 'xen', '', d)} \
"

INHERIT += "cve-check"
UBOOT_DTB_NAME = "imx8mp-evk.dtb"
INHERIT:remove = "create-spdx"
INHERIT += "create-spdx-2.2"
SPDX_GENERATE_PACKAGE = "1"
```

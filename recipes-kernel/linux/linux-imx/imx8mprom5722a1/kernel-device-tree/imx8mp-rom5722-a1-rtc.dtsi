/ {
    aliases {
        rtc0 = &s35390a;
        rtc1 = &snvs_rtc;
    };
};

&i2c1 {
    s35390a: s35390a@30 {
        compatible = "sii,s35390a";
        reg = <0x30>;
        status = "okay";
    };
};


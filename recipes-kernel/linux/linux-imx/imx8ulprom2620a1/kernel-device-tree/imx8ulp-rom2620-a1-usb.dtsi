&usbotg2 {
	pinctrl-names = "default", "sleep";
	pinctrl-0 = <&pinctrl_otgid2>;
	pinctrl-1 = <&pinctrl_otgid2>;
};

&iomuxc1 {
	pinctrl_otgid2: usb2grp {
		fsl,pins = <
			MX8ULP_PAD_PTF0__USB1_ID	0x10003
			MX8ULP_PAD_PTF6__USB1_OC	0x10003
		>;
	};
};

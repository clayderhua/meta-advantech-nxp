&iomuxc0 {
	pinctrl-names = "default";
	pinctrl-0 = <&pinctrl_hog_0>;

	pinctrl_hog_0: hog0grp {
		fsl,pins = <
			MX8ULP_PAD_PTA5__PTA5_GPIOA	0x3
			MX8ULP_PAD_PTB0__PTB0_GPIOB	0x3
			MX8ULP_PAD_PTB1__PTB1_GPIOB	0x3
			MX8ULP_PAD_PTB6__PTB6_GPIOB	0x3
			MX8ULP_PAD_PTC0__PTC0_GPIOC	0x3
			MX8ULP_PAD_PTC1__PTC1_GPIOC	0x3
			MX8ULP_PAD_PTC2__PTC2_GPIOC	0x3
			MX8ULP_PAD_PTC3__PTC3_GPIOC	0x3
			MX8ULP_PAD_PTC4__PTC4_GPIOC	0x3
			MX8ULP_PAD_PTC12__PTC12_GPIOC	0x3
			MX8ULP_PAD_PTC18__PTC18_GPIOC	0x3
			MX8ULP_PAD_PTC19__PTC19_GPIOC	0x3
			MX8ULP_PAD_PTC20__PTC20_GPIOC	0x3
		>;
	};
};

&iomuxc1 {
	pinctrl-names = "default";
	pinctrl-0 = <&pinctrl_hog_1>;

	pinctrl_hog_1: hog1grp {
		fsl,pins = <
			MX8ULP_PAD_PTD12__PTD12		0x3
			MX8ULP_PAD_PTD13__PTD13		0x3
			MX8ULP_PAD_PTF1__PTF1		0x3
		>;
	};
};

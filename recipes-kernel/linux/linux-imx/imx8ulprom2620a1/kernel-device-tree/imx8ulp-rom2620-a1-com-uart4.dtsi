
&lpuart4 {
	pinctrl-names = "default", "sleep";
	pinctrl-0 = <&pinctrl_lpuart4>;
	pinctrl-1 = <&pinctrl_lpuart4>;
	fsl,uart-has-rtscts;
	linux,rs485-enabled-at-boot-time;
	rs485-rx-during-tx;
	status = "okay";
};

&iomuxc1 {
	pinctrl_lpuart4: lpuart4grp {
		fsl,pins = <
			MX8ULP_PAD_PTF8__LPUART4_CTS_B	0x3
			MX8ULP_PAD_PTF9__LPUART4_RTS_B	0x3
			MX8ULP_PAD_PTF10__LPUART4_TX	0x3
			MX8ULP_PAD_PTF11__LPUART4_RX	0x3
		>;
	};
};

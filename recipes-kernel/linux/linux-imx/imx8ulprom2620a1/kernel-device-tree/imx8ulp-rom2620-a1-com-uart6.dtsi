
&lpuart6 {
	pinctrl-names = "default", "sleep";
	pinctrl-0 = <&pinctrl_lpuart6>;
	pinctrl-1 = <&pinctrl_lpuart6>;
	status = "okay";
};

&iomuxc1 {
	pinctrl_lpuart6: lpuart6grp {
		fsl,pins = <
			MX8ULP_PAD_PTE10__LPUART6_TX	0x3
			MX8ULP_PAD_PTE11__LPUART6_RX	0x3
		>;
	};
};

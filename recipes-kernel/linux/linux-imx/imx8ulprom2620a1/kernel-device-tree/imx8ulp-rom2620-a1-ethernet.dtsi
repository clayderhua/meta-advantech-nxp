&fec {
	pinctrl-0 = <&pinctrl_enet>;
	pinctrl-1 = <&pinctrl_enet>;
};

&iomuxc1 {
	pinctrl_enet: enetgrp {
		fsl,pins = <
			MX8ULP_PAD_PTE15__ENET0_MDC	0x7
			MX8ULP_PAD_PTE14__ENET0_MDIO	0x7
			MX8ULP_PAD_PTE17__ENET0_RXER	0x7
			MX8ULP_PAD_PTE18__ENET0_CRS_DV	0x43
			MX8ULP_PAD_PTE21__ENET0_RXD0	0x43
			MX8ULP_PAD_PTE20__ENET0_RXD1	0x43
			MX8ULP_PAD_PTE16__ENET0_TXEN	0x7
			MX8ULP_PAD_PTE23__ENET0_TXD0	0x7
			MX8ULP_PAD_PTE22__ENET0_TXD1	0x7
			MX8ULP_PAD_PTE19__ENET0_REFCLK	0x43
		>;
	};
};
